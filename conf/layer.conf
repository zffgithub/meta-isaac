## conf/layer.conf
```bitbake
# We have a conf and classes directory, append to BBPATH
BBPATH .= ":${LAYERDIR}"

# We have a recipes directory, add to BBFILES
BBFILES += "${LAYERDIR}/recipes-*/*/*.bb ${LAYERDIR}/recipes-*/*/*.bbappend ${LAYERDIR}/generated-recipes/*/*.bb"

BBFILE_COLLECTIONS += "isaac-ros2-layer"
BBFILE_PATTERN_isaac-ros2-layer := "^${LAYERDIR}/"
BBFILE_PRIORITY_isaac-ros2-layer = "50"

LAYERVERSION_isaac-ros2-layer = "1"
LAYERSERIES_COMPAT_isaac-ros2-layer = "kirkstone"
```
